#include "msm8953-camera-sensor-qrd-overlay.dtsi "
#include "msm8953-regulator-overlay.dtsi"
#include "msm8953-thermal-overlay.dtsi"
#include "msm8953-pinctrl-overlay.dtsi"
#include "dsi-panel-ili9881h-720p-video.dtsi"
#include "dsi-panel-inx6301-720p-video.dtsi"
#include "pm8953-overlay.dtsi"
#include "pmi632-overlay.dtsi"
#include "sdm450-pmi632-overlay.dtsi"
#include "sdm632-regulator-overlay.dtsi"